# file: REGISTER_TIMER.ioc
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Mcu.Family=STM32F4
Mcu.Name=STM32F407V(E-G)Tx
Mcu.Package=LQFP100
NVIC.PriorityGroup=NVIC_PRIORITYGROUP_4
ProjectManager.HeapSize=0x200
ProjectManager.StackSize=0x400
ProjectManager.TargetToolchain=STM32CubeIDE
RCC.AHBFreq_Value=16000000
RCC.APB1Freq_Value=16000000
RCC.APB2Freq_Value=16000000
RCC.CortexFreq_Value=16000000
RCC.HSE_VALUE=25000000
RCC.HSI_VALUE=16000000
RCC.LSE_VALUE=32768
RCC.SYSCLKFreq_VALUE=16000000
RCC.VCOOutputFreq_Value=192000000
board=custom

// file: Core/Src/main.c
/* USER CODE BEGIN Header */
/**
  ******************************************************************************
  * @file           : main.c
  * @brief          : Main program body
  ******************************************************************************
  * @attention
  *
  * Copyright (c) 2024 STMicroelectronics.
  * All rights reserved.
  *
  * This software is licensed under terms that can be found in the LICENSE file
  * in the root directory of this software component.
  * If no LICENSE file comes with this software, it is provided AS-IS.
  *
  ******************************************************************************
  */
/* USER CODE END Header */
#include "main.h"

/* USER CODE BEGIN PV */
int16_t count=0;
/* USER CODE END PV */

void SystemClock_Config(void);

/* USER CODE BEGIN 0 */
void RCC_Config(void)
{
	RCC->CR |= 0x00010000; //HSEON enable
	while(!(RCC->CR & 0x00020000)); //HSEON Ready Flag wait
	RCC->CR |= 0x00080000; // CSS Enable
	RCC->CR |= 0x01000000; //PLL ON
	RCC->PLLCFGR |= 0x00400000;// PLL e HSE
	RCC->PLLCFGR |= 0x00000004;// PLL M = 4
	RCC->PLLCFGR |= 0x00005A00;// PLL N = 168
	RCC->PLLCFGR |= 0x00000000;// PLL P = 2
	RCC->CFGR |=0x00000000; //AHB Prescaler = 1
	RCC->CFGR |=0x00080000; //APB2 Prescaler = 2
	RCC->CFGR |=0x00001400; //APB1 Prescaler = 4
	RCC->CIR |= 0x00080000; //HSERDY Flag clear
	RCC->CIR |= 0x00800000; // CSS Flag clear
}

void TIM_Config(void)
{
	// Time2 clock enable
	RCC->APB1ENR  |= 1<<0; // same : RCC->APB1ENR  |= 0x00000001;

	//TIMx control register 1 (TIMx_CR1)
	TIM2->CR1 |= 1<<0; //CEN Timer2 Counter Enable
	TIM2->CR1 &= ~(1<<4); //Bit 4 DIR Direction // Upcounter here
						//   0: Counter used as upcounter
						// 	 1: Counter used as downcounter

	//Bits 6:5 CMS Center-aligned mode selection
		//00 Edge-aligned mode. The Counter countes up or down depending on the direction bit (DIR)
	TIM2->CR1 &= ~( 1<<5 || 1<<6 );

	//Bits 9:8  CKD : Clock Division
				// 00 tDTS = tCK_INT  // directly timer clock
				// 01 tDTS = 2 x tCK_INT // timer clock twice
				//...
	TIM2->CR1 &= ~(1<<9 || 1<<8); // Directly timer clock

	// TIMx slave mode control register  TIMx_SMCR

	// Bits 2:0 SMS Slave Mode Selection
			//  000: Slave mode disabled - if CEN = ‘1 then the prescaler is clocked directly by the internal clock.
	TIM2->SMCR &= ~(1<<0 || 1<<1 || 1<<2 );

	TIM2->EGR |= 1<<0; // Timer update generation // Especially after some configuration such as prescaler or auto-reload

	//TIMx Counter (TIMx_CNT) // Read or write counter
			//Bits 31:16CNT[31:16]: High counter value (on TIM2 and TIM5).
			//Bits 15:0CNT[15:0]: Counter value

	//TIMx prescaler (TIMx_PSC) // That is prescaler
	/*
	 Bits 15:0 PSC[15:0]: Prescaler value
 The counter clock frequency CK_CNT is equal to fCK_PSC / (PSC[15:0] + 1).
 PSC contains the value to be loaded in the active prescaler register at each update event
(including when the counter is cleared through UG bit of TIMx_EGR register or through
trigger controller when configured in “reset mode”).
	 */
	TIM2->PSC = 41999; // We set prescaler value = 41999

	//TIMx auto-reload register (TIMx_ARR) // That is period
	/*
	 Bits 31:16ARR[31:16]: High auto-reload value (on TIM2 and TIM5).
 Bits 15:0 ARR[15:0]: Auto-reload value
 ARR is the value to be loaded in the actual auto-reload register.
 Refer to the Section18.3.1: Time-base unit for more details about ARR update and
behavior.
 The counter is blocked while the auto-reload value is null.
	 */
	TIM2->ARR =2000;

	//1 second = (TIM->PSC + 1) * (TIM2->ARR + 1)  /  TIME CLOCK
}

/* USER CODE END 0 */

int main(void)
{

  /* MCU Configuration--------------------------------------------------------*/

  /* Reset of all peripherals, Initializes the Flash interface and the Systick. */
  //HAL_Init();

  /* Configure the system clock */
  //SystemClock_Config();

  /* USER CODE BEGIN SysInit */

	RCC_Config();
	TIM_Config();
  /* USER CODE END SysInit */

  /* Initialize all configured peripherals */

  /* Infinite loop */
  /* USER CODE BEGIN WHILE */
  while (1)
  {
	  count = TIM2->CNT;
    /* USER CODE END WHILE */

  }
}

void SystemClock_Config(void)
{
  RCC_OscInitTypeDef RCC_OscInitStruct = {0};
  RCC_ClkInitTypeDef RCC_ClkInitStruct = {0};

  /** Configure the main internal regulator output voltage
  */
  __HAL_RCC_PWR_CLK_ENABLE();
  __HAL_PWR_VOLTAGESCALING_CONFIG(PWR_REGULATOR_VOLTAGE_SCALE1);

  /** Initializes the RCC Oscillators according to the specified parameters
  * in the RCC_OscInitTypeDef structure.
  */
  RCC_OscInitStruct.OscillatorType = RCC_OSCILLATORTYPE_HSI;
  RCC_OscInitStruct.HSIState = RCC_HSI_ON;
  RCC_OscInitStruct.HSICalibrationValue = RCC_HSICALIBRATION_DEFAULT;
  RCC_OscInitStruct.PLL.PLLState = RCC_PLL_NONE;
  if (HAL_RCC_OscConfig(&RCC_OscInitStruct) != HAL_OK)
  {
    Error_Handler();
  }

  /** Initializes the CPU, AHB and APB buses clocks
  */
  RCC_ClkInitStruct.ClockType = RCC_CLOCKTYPE_HCLK|RCC_CLOCKTYPE_SYSCLK
                              |RCC_CLOCKTYPE_PCLK1|RCC_CLOCKTYPE_PCLK2;
  RCC_ClkInitStruct.SYSCLKSource = RCC_SYSCLKSOURCE_HSI;
  RCC_ClkInitStruct.AHBCLKDivider = RCC_SYSCLK_DIV1;
  RCC_ClkInitStruct.APB1CLKDivider = RCC_HCLK_DIV1;
  RCC_ClkInitStruct.APB2CLKDivider = RCC_HCLK_DIV1;

  if (HAL_RCC_ClockConfig(&RCC_ClkInitStruct, FLASH_LATENCY_0) != HAL_OK)
  {
    Error_Handler();
  }
}

void Error_Handler(void)
{
  __disable_irq();
  while (1)
  {
  }
}
