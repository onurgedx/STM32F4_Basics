# file: REGISTER_I2C.ioc
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Mcu.Family=STM32F4
Mcu.Name=STM32F407V(E-G)Tx
Mcu.Package=LQFP100
NVIC.PriorityGroup=NVIC_PRIORITYGROUP_4
ProjectManager.HeapSize=0x200
ProjectManager.StackSize=0x400
ProjectManager.TargetToolchain=STM32CubeIDE
RCC.AHBFreq_Value=16000000
RCC.APB1Freq_Value=16000000
RCC.APB2Freq_Value=16000000
RCC.CortexFreq_Value=16000000
RCC.HSE_VALUE=25000000
RCC.HSI_VALUE=16000000
RCC.LSE_VALUE=32768
RCC.SYSCLKFreq_VALUE=16000000
RCC.VCOOutputFreq_Value=192000000
board=custom

// file: Core/Src/main.c
/* USER CODE BEGIN Header */
/**
  ******************************************************************************
  * @file           : main.c
  * @brief          : Main program body
  ******************************************************************************
  * @attention
  *
  * Copyright (c) 2024 STMicroelectronics.
  * All rights reserved.
  *
  * This software is licensed under terms that can be found in the LICENSE file
  * in the root directory of this software component.
  * If no LICENSE file comes with this software, it is provided AS-IS.
  *
  ******************************************************************************
  */
/* USER CODE END Header */
#include "main.h"

void SystemClock_Config(void);

/* USER CODE BEGIN 0 */
void RCC_Config()
{
    // HSE (High Speed External clock) Oscillator Enable
    RCC->CR |= 0x00010000;

    // Wait until HSE is ready
    while (!(RCC->CR & 0x00020000));

    // PLL (Phase Locked Loop) Enable
    RCC->CR |= 0x01000000;

    // Configure PLL: PLL Source = HSE, PLL_M = 4, PLL_N = 168, PLL_P = 2
    RCC->PLLCFGR |= 0x00400000;  // PLL Source = HSE
    RCC->PLLCFGR |= 0x00000004;  // PLL_M = 4
    RCC->PLLCFGR |= 0x00005A00;  // PLL_N = 168
    RCC->PLLCFGR |= 0x00000000;  // PLL_P = 2

    // Configure AHB and APB Prescalers
    RCC->CFGR |= 0x00000000;     // AHB Prescaler = 1
    RCC->CFGR |= 0x00008000;     // APB2 Prescaler = 2
    RCC->CFGR |= 0x00001400;     // APB1 Prescaler = 4

    // Clear Flags (optional, depending on initialization sequence)
    RCC->CIR = 0x00800000;       // Clear HSE Ready Interrupt Flag
}

void GPIO_Config()
{
	RCC->AHB1ENR |= 3<<0; // GPIOA and GPIOB clock enabled
	GPIOB-> AFR[1] |= (4<<8) | (4<<12)   ;  // PB10 and PB11 AF4  (I2C)
	GPIOB->MODER |= (2<<20) | (2<<22); //PB10 and PB11 AF
	GPIOB->OTYPER |= (1<<11) | (1<<12); // Open-Drain
}

void I2C_Config()
{
	RCC->APB1ENR |= 1<<22; // i2c clock enable

	I2C2->CR2 |= 0x0008;	// i2c clock 8MHz
	I2C2->CRR |= 0x0028;	// i2c 100 kHz
	I2C2->TRISE |= 0x09;
	I2C2->CR1 |= 0x0001; // i2c enable
}

uint8_t m_adress = 0x4E;
void I2C_Write(uint8_ adresss, uint8_t data)
{
	I2C2->CR1 |=1<<8; // send start bit
	while(!(I2C2->SR1 & 0x0001)); 	// wait for start
	I2C2->DR |=0x4E; // slave adress
	while(!(I2C2->SR1 & 0x0002)); // wait send adress (acknowledge)
	while(!(I2C2->SR2 & 0x0001)); // wiat Master selected

	//I2C2->DR = adress

	while(!(I2C2->SR1 & 0x0080 )); // wait until TXE empty

	I2C2->DR = data;
	while(!(I2C2->SR1 & 0x0080 )); // wait until TXE empty

	while(!(I2C2->SR1 & 0x0004 )); // wait until BTF successful

	I2C2->CR1 |= 1<<9;			// send stop bit

}

/* USER CODE END 0 */

int main(void)
{

  /* MCU Configuration--------------------------------------------------------*/

  /* Reset of all peripherals, Initializes the Flash interface and the Systick. */
  //HAL_Init();

  /* Configure the system clock */
  //SystemClock_Config();

  /* Initialize all configured peripherals */
  /* USER CODE BEGIN 2 */
	RCC_Config();
	GPIO_Config();
	I2C_Config();
  /* USER CODE END 2 */

  /* Infinite loop */
  while (1)
  {

  }
}

void SystemClock_Config(void)
{
  RCC_OscInitTypeDef RCC_OscInitStruct = {0};
  RCC_ClkInitTypeDef RCC_ClkInitStruct = {0};

  /** Configure the main internal regulator output voltage
  */
  __HAL_RCC_PWR_CLK_ENABLE();
  __HAL_PWR_VOLTAGESCALING_CONFIG(PWR_REGULATOR_VOLTAGE_SCALE1);

  /** Initializes the RCC Oscillators according to the specified parameters
  * in the RCC_OscInitTypeDef structure.
  */
  RCC_OscInitStruct.OscillatorType = RCC_OSCILLATORTYPE_HSI;
  RCC_OscInitStruct.HSIState = RCC_HSI_ON;
  RCC_OscInitStruct.HSICalibrationValue = RCC_HSICALIBRATION_DEFAULT;
  RCC_OscInitStruct.PLL.PLLState = RCC_PLL_NONE;
  if (HAL_RCC_OscConfig(&RCC_OscInitStruct) != HAL_OK)
  {
    Error_Handler();
  }

  /** Initializes the CPU, AHB and APB buses clocks
  */
  RCC_ClkInitStruct.ClockType = RCC_CLOCKTYPE_HCLK|RCC_CLOCKTYPE_SYSCLK
                              |RCC_CLOCKTYPE_PCLK1|RCC_CLOCKTYPE_PCLK2;
  RCC_ClkInitStruct.SYSCLKSource = RCC_SYSCLKSOURCE_HSI;
  RCC_ClkInitStruct.AHBCLKDivider = RCC_SYSCLK_DIV1;
  RCC_ClkInitStruct.APB1CLKDivider = RCC_HCLK_DIV1;
  RCC_ClkInitStruct.APB2CLKDivider = RCC_HCLK_DIV1;

  if (HAL_RCC_ClockConfig(&RCC_ClkInitStruct, FLASH_LATENCY_0) != HAL_OK)
  {
    Error_Handler();
  }
}

void Error_Handler(void)
{
  __disable_irq();
  while (1)
  {
  }
}
